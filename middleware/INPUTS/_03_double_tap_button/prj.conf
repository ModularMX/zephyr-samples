## prj.conf
```kconfig
# Include GPIO driver in system config
CONFIG_GPIO=y

# Include INPUT subsystem
CONFIG_INPUT=y

# Enable input double tap driver
CONFIG_INPUT_DOUBLE_TAP=y
```

## boards/xiao_esp32c6_hpcore.overlay
```dts
/*
 * XIAO ESP32C6 overlay for double tap button example
 * Uses GPIO18 (onboard button) with internal pull-up
 */

#include <zephyr/dt-bindings/input/input-event-codes.h>

/ {
	buttons: buttons {
		compatible = "gpio-keys";
		
		button0: button_0 {
			gpios = <&gpio0 18 (GPIO_PULL_UP | GPIO_ACTIVE_LOW)>;
			zephyr,code = <INPUT_KEY_0>;
		};
	};

	double_tap {
		compatible = "zephyr,input-double-tap";
		input = <&buttons>;
		input-codes = <INPUT_KEY_0>;        /* Monitor button 0 */
		double-tap-codes = <INPUT_KEY_A>;   /* Emit KEY_A on double tap */
		double-tap-delay-ms = <300>;        /* 300ms window between taps */
	};
};
```

## src/main.c
```c
#include <zephyr/kernel.h>
#include <zephyr/input/input.h>

static void button_callback(struct input_event *evt, void *user_data)
{
	if (evt->type != INPUT_EV_KEY) {
		return;
	}

	/* Only respond to press events (value == 1) */
	if (evt->value != 1) {
		return;
	}

	switch (evt->code) {
	case INPUT_KEY_0:
		printk("Single tap detected\n");
		break;
	
	case INPUT_KEY_A:
		printk("DOUBLE TAP detected!\n");
		break;
	}
}

INPUT_CALLBACK_DEFINE(NULL, button_callback, NULL);

int main(void)
{
	printk("Double Tap Button Example\n");
	printk("Press the button twice quickly (within 300ms) to trigger double tap\n");
	printk("Waiting for button events...\n");
	
	return 0;
}
```
