## CMakeLists.txt
```
# SPDX-License-Identifier: Apache-2.0

cmake_minimum_required(VERSION 3.20.0)

find_package(Zephyr REQUIRED HINTS $ENV{ZEPHYR_BASE})
find_package(Python REQUIRED COMPONENTS Interpreter)

project(http_server)

if(CONFIG_NET_SOCKETS_SOCKOPT_TLS AND
  CONFIG_MBEDTLS_KEY_EXCHANGE_PSK_ENABLED AND
  (CONFIG_NET_SAMPLE_PSK_HEADER_FILE STREQUAL "dummy_psk.h")
)
  add_custom_target(development_psk
    COMMAND ${CMAKE_COMMAND} -E echo "----------------------------------------------------------"
    COMMAND ${CMAKE_COMMAND} -E echo "--- WARNING: Using dummy PSK! Only suitable for        ---"
    COMMAND ${CMAKE_COMMAND} -E echo "--- development. Set NET_SAMPLE_PSK_HEADER_FILE to use ---"
    COMMAND ${CMAKE_COMMAND} -E echo "--- own pre-shared key.                                ---"
    COMMAND ${CMAKE_COMMAND} -E echo "----------------------------------------------------------"
  )
  add_dependencies(app development_psk)
endif()

set(CERTS_DIR ${CMAKE_CURRENT_SOURCE_DIR}/src/certs)

# Create custom command to generate certificates
add_custom_command(
  OUTPUT
    ${CERTS_DIR}/server_cert.der
    ${CERTS_DIR}/server_privkey.der
    ${CERTS_DIR}/ca_cert.der
    ${CERTS_DIR}/server_cert.pem
    ${CERTS_DIR}/server_privkey.pem
    ${CERTS_DIR}/ca_cert.pem
    ${CERTS_DIR}/ca_privkey.pem
  WORKING_DIRECTORY ${CERTS_DIR}
  COMMAND ${Python_EXECUTABLE} generate_certificates.py
  COMMENT "Generating TLS certificates"
  VERBATIM
)

# Add a target that depends on the certificate outputs
add_custom_target(sample_ca_cert DEPENDS
  ${CERTS_DIR}/server_cert.der
  ${CERTS_DIR}/server_privkey.der
  ${CERTS_DIR}/ca_cert.der
)

add_custom_target(sample_server_cert DEPENDS
  ${CERTS_DIR}/server_cert.der
  ${CERTS_DIR}/server_privkey.der
)

option(INCLUDE_HTML_CONTENT "Include the HTML content" ON)

target_sources(app PRIVATE src/main.c)

# Add project root to include paths so certificate.h can be found
target_include_directories(app PRIVATE ${CMAKE_CURRENT_SOURCE_DIR})

set(gen_dir ${ZEPHYR_BINARY_DIR}/include/generated/)

# Generate gzipped include files for web resources
foreach(web_resource
  index.html
  main.js
)
  generate_inc_file_for_target(app
    src/static_web_resources/${web_resource}
    ${gen_dir}/${web_resource}.gz.inc
    --gzip
  )
endforeach()

# if(CONFIG_USB_DEVICE_STACK_NEXT)
#   include(${ZEPHYR_BASE}/samples/subsys/usb/common/common.cmake)
# endif()

target_link_libraries(app PRIVATE zephyr_interface zephyr)

zephyr_linker_sources(SECTIONS sections-rom.ld)
zephyr_linker_section_ifdef(CONFIG_NET_SAMPLE_HTTPS_SERVICE
  NAME http_resource_desc_https_service
  KVMA RAM_REGION GROUP RODATA_REGION
)

foreach(inc_file
  server_cert.der
  server_privkey.der
)
  generate_inc_file_for_target(app
    src/certs/${inc_file}
    ${gen_dir}/${inc_file}.inc
  )
  # Ensure certificates are generated before inc files are generated
  add_dependencies(app sample_ca_cert)
endforeach()
```

## prj.conf
```kconfig
# General config
CONFIG_MAIN_STACK_SIZE=3072
CONFIG_SYSTEM_WORKQUEUE_STACK_SIZE=2048
CONFIG_LOG=y
CONFIG_POSIX_API=y

# Networking config
CONFIG_NETWORKING=y
CONFIG_NET_IPV4=y
CONFIG_NET_TCP=y
CONFIG_NET_L2_ETHERNET=y
CONFIG_NET_MGMT=y
CONFIG_NET_MGMT_EVENT=y
CONFIG_NET_SOCKETS=y
CONFIG_NET_CONTEXT_NET_PKT_POOL=y
CONFIG_NET_STATISTICS=y
CONFIG_TEST_RANDOM_GENERATOR=y

# Network buffers
CONFIG_NET_PKT_RX_COUNT=16
CONFIG_NET_PKT_TX_COUNT=16
CONFIG_NET_BUF_RX_COUNT=128
CONFIG_NET_BUF_TX_COUNT=128

# Logging
CONFIG_LOG_BUFFER_SIZE=2048
CONFIG_LOG_BACKEND_UART_ASYNC=y

# Enable connection manager and HTTP server
CONFIG_NET_CONNECTION_MANAGER=y
CONFIG_HTTP_PARSER_URL=y
CONFIG_HTTP_PARSER=y
CONFIG_HTTP_SERVER=y
CONFIG_HTTP_SERVER_MAX_CLIENTS=4

# JSON support for dynamic responses
CONFIG_JSON_LIBRARY=y

# Network address config (Static IP - HTTP server on device)
CONFIG_NET_CONFIG_SETTINGS=y
CONFIG_NET_CONFIG_NEED_IPV4=y
CONFIG_NET_CONFIG_MY_IPV4_ADDR="192.168.1.100"
CONFIG_NET_CONFIG_MY_IPV4_NETMASK="255.255.255.0"
CONFIG_NET_CONFIG_MY_IPV4_GW="192.168.1.1"

# IP address options
CONFIG_NET_IF_UNICAST_IPV6_ADDR_COUNT=3
CONFIG_NET_IF_MCAST_IPV6_ADDR_COUNT=4
CONFIG_NET_MAX_CONTEXTS=32
CONFIG_NET_MAX_CONN=32

# Device drivers
CONFIG_GPIO=y
CONFIG_LED=y


# TLS configuration
CONFIG_MBEDTLS=y
CONFIG_MBEDTLS_BUILTIN=y
CONFIG_MBEDTLS_ENABLE_HEAP=y
CONFIG_MBEDTLS_HEAP_SIZE=60000
CONFIG_MBEDTLS_SSL_MAX_CONTENT_LEN=2048
CONFIG_NET_SOCKETS_SOCKOPT_TLS=y
CONFIG_NET_SOCKETS_TLS_MAX_CONTEXTS=6
CONFIG_TLS_CREDENTIALS=y
CONFIG_TLS_MAX_CREDENTIALS_NUMBER=5
CONFIG_PSA_WANT_ALG_ECDH=y
CONFIG_PSA_WANT_ALG_ECDSA=y
CONFIG_PSA_WANT_ECC_SECP_R1_256=y
CONFIG_PSA_WANT_KEY_TYPE_ECC_PUBLIC_KEY=y
CONFIG_PSA_WANT_KEY_TYPE_ECC_KEY_PAIR_IMPORT=y
CONFIG_PSA_WANT_KEY_TYPE_ECC_KEY_PAIR_EXPORT=y
CONFIG_PSA_WANT_KEY_TYPE_ECC_KEY_PAIR_GENERATE=y
CONFIG_MBEDTLS_KEY_EXCHANGE_ECDHE_ECDSA_ENABLED=y
CONFIG_PSA_WANT_ALG_CCM=y
CONFIG_PSA_WANT_ALG_GCM=y
CONFIG_MBEDTLS_PK_WRITE_C=y
CONFIG_PSA_WANT_ALG_TLS12_PRF=y
CONFIG_PSA_WANT_ALG_SHA_1=y
CONFIG_PSA_WANT_ALG_SHA_256=y

CONFIG_NET_SAMPLE_HTTPS_SERVICE=y

# PSK configuration for TLS
CONFIG_MBEDTLS_KEY_EXCHANGE_PSK_ENABLED=y
CONFIG_NET_SAMPLE_PSK_HEADER_FILE="dummy_psk.h"
```

## src/main.c
```c
// HTTPS Server Example for Zephyr with TLS
// Based on _11_http_server_basic with added TLS/HTTPS support
//
// SPDX-License-Identifier: Apache-2.0

#include <stdio.h>
#include <inttypes.h>
#include <string.h>

#include <zephyr/kernel.h>
#include <zephyr/net/tls_credentials.h>
#include <zephyr/net/http/server.h>
#include <zephyr/net/http/service.h>
#include <zephyr/net/net_ip.h>
#include <zephyr/net/socket.h>
#include <zephyr/net/net_config.h>

// HTTPS server configuration
#define HTTPS_SERVER_PORT 4443
#define MAX_HTTPS_CLIENTS 4

// =============================================================================
// STATIC RESOURCES (Compressed with gzip)
// =============================================================================

// HTML content - compressed at build time
static const uint8_t index_html_gz[] = {
#include "index.html.gz.inc"
};

// JavaScript content - compressed at build time
static const uint8_t main_js_gz[] = {
#include "main.js.gz.inc"
};

// =============================================================================
// RESOURCE DEFINITIONS
// =============================================================================

// Index.html resource - served at "/" endpoint
// Client sends: GET /
// Server responds: HTML page (gzipped)
static struct http_resource_detail_static index_html_resource_detail = {
	.common = {
		.type = HTTP_RESOURCE_TYPE_STATIC,
		.bitmask_of_supported_http_methods = BIT(HTTP_GET),
		.content_encoding = "gzip",
		.content_type = "text/html",
	},
	.static_data = index_html_gz,
	.static_data_len = sizeof(index_html_gz),
};

// Main.js resource - served at "/main.js" endpoint
// Client sends: GET /main.js
// Server responds: JavaScript file (gzipped)
static struct http_resource_detail_static main_js_resource_detail = {
	.common = {
		.type = HTTP_RESOURCE_TYPE_STATIC,
		.bitmask_of_supported_http_methods = BIT(HTTP_GET),
		.content_encoding = "gzip",
		.content_type = "text/javascript",
	},
	.static_data = main_js_gz,
	.static_data_len = sizeof(main_js_gz),
};

// =============================================================================
// DYNAMIC RESOURCE HANDLERS
// =============================================================================

// Device info handler - returns device information as JSON
// Client sends: GET /device-info
// Server responds: JSON with board, architecture, uptime, status
static int device_info_handler(struct http_client_ctx *client, enum http_data_status status,
							   const struct http_request_ctx *request_ctx,
							   struct http_response_ctx *response_ctx, void *user_data)
{
	// Buffer for JSON response
	static char info_buf[256];
	int len;

	printk("[HTTPS] Device info handler called, status: %d\n", status);

	// Wait for all request data to be received before responding
	if (status == HTTP_SERVER_DATA_FINAL)
	{
		// Build JSON response with device information
		len = snprintf(info_buf, sizeof(info_buf),
					   "{\"board\":\"STM32H573I-DK\","
					   "\"arch\":\"ARM Cortex-M33\","
					   "\"uptime\":%" PRId64 ","
					   "\"status\":\"Running\"}",
					   k_uptime_get());

		if (len < 0 || len >= (int)sizeof(info_buf))
		{
			printk("[ERR] Failed to format device info\n");
			return -ENOMEM;
		}

		// Set response body and mark as complete
		response_ctx->body = (uint8_t *)info_buf;
		response_ctx->body_len = len;
		response_ctx->final_chunk = true;
	}

	return 0;
}

static struct http_resource_detail_dynamic device_info_resource_detail = {
	.common = {
		.type = HTTP_RESOURCE_TYPE_DYNAMIC,
		.bitmask_of_supported_http_methods = BIT(HTTP_GET),
	},
	.cb = device_info_handler,
	.user_data = NULL,
};

// Echo handler - echoes back the received data
// Client sends: GET /echo or POST /echo with body
// Server responds: Same body data back to client
static int echo_handler(struct http_client_ctx *client, enum http_data_status status,
						const struct http_request_ctx *request_ctx,
						struct http_response_ctx *response_ctx, void *user_data)
{
	enum http_method method = client->method;

	// Handle aborted transactions (connection closed by client)
	if (status == HTTP_SERVER_DATA_ABORTED)
	{
		printk("[HTTPS] Echo transaction aborted\n");
		return 0;
	}

	// Log received data
	if (request_ctx->data_len > 0)
	{
		printk("[HTTPS] %s received %zd bytes\n", http_method_str(method), request_ctx->data_len);
	}

	// Echo data back to client
	response_ctx->body = request_ctx->data;
	response_ctx->body_len = request_ctx->data_len;
	// Mark as final chunk if all data received
	response_ctx->final_chunk = (status == HTTP_SERVER_DATA_FINAL);

	return 0;
}

static struct http_resource_detail_dynamic echo_resource_detail = {
	.common = {
		.type = HTTP_RESOURCE_TYPE_DYNAMIC,
		.bitmask_of_supported_http_methods = BIT(HTTP_GET) | BIT(HTTP_POST),
	},
	.cb = echo_handler,
	.user_data = NULL,
};

// =============================================================================
// TLS CERTIFICATE CONFIGURATION
// =============================================================================

#include "certificate.h"

static const sec_tag_t sec_tag_list_verify_none[] = {
	HTTP_SERVER_CERTIFICATE_TAG,
	PSK_TAG,
};

static void setup_tls(void)
{
	int err;

	printk("[HTTPS] Setting up TLS credentials\n");

	err = tls_credential_add(HTTP_SERVER_CERTIFICATE_TAG,
							 TLS_CREDENTIAL_SERVER_CERTIFICATE,
							 server_certificate, sizeof(server_certificate));
	if (err < 0)
	{
		printk("[ERR] Failed to register server certificate: %d\n", err);
	}

	err = tls_credential_add(HTTP_SERVER_CERTIFICATE_TAG,
							 TLS_CREDENTIAL_PRIVATE_KEY,
							 private_key, sizeof(private_key));
	if (err < 0)
	{
		printk("[ERR] Failed to register private key: %d\n", err);
	}

	err = tls_credential_add(PSK_TAG,
							 TLS_CREDENTIAL_PSK,
							 psk,
							 sizeof(psk));
	if (err < 0)
	{
		printk("[ERR] Failed to register PSK: %d\n", err);
	}

	err = tls_credential_add(PSK_TAG,
							 TLS_CREDENTIAL_PSK_ID,
							 psk_id,
							 sizeof(psk_id) - 1);
	if (err < 0)
	{
		printk("[ERR] Failed to register PSK ID: %d\n", err);
	}
}

// =============================================================================
// HTTPS SERVICE CONFIGURATION
// =============================================================================

// Define the HTTPS service with TLS
// - Listens on all interfaces (NULL = bind to all)
// - Port: 4443
// - Max 4 simultaneous clients
// - Max 10 streams per client
// - Uses TLS with credentials
static uint16_t https_service_port = HTTPS_SERVER_PORT;
HTTPS_SERVICE_DEFINE(https_service, NULL, &https_service_port,
					 MAX_HTTPS_CLIENTS, 10, NULL, NULL, NULL, sec_tag_list_verify_none,
					 sizeof(sec_tag_list_verify_none));

// =============================================================================
// RESOURCE ROUTING
// =============================================================================

// Route "/" -> static HTML
HTTP_RESOURCE_DEFINE(index_resource, https_service, "/", &index_html_resource_detail);

// Route "/main.js" -> static JavaScript
HTTP_RESOURCE_DEFINE(main_js_resource, https_service, "/main.js", &main_js_resource_detail);

// Route "/device-info" -> dynamic endpoint (calls device_info_handler)
HTTP_RESOURCE_DEFINE(device_info_resource, https_service, "/device-info", &device_info_resource_detail);

// Route "/echo" -> dynamic endpoint (echoes back data)
HTTP_RESOURCE_DEFINE(echo_resource, https_service, "/echo", &echo_resource_detail);

// =============================================================================
// MAIN APPLICATION
// =============================================================================

int main(void)
{
	printk("[HTTPS] Starting HTTPS Server on port %d\n", HTTPS_SERVER_PORT);
	printk("[HTTPS] Available endpoints:\n");
	printk("[HTTPS]   GET  /              -> HTML page\n");
	printk("[HTTPS]   GET  /main.js       -> JavaScript\n");
	printk("[HTTPS]   GET  /device-info   -> Device information (JSON)\n");
	printk("[HTTPS]   GET/POST /echo      -> Echo server\n");

	// Setup TLS credentials before starting the server
	setup_tls();

	// Start the HTTPS server (blocking call)
	http_server_start();

	return 0;
}
```
