## CMakeLists.txt
```
# Minimum CMake required version
cmake_minimum_required( VERSION 3.20.0 )

# Get Zephyr directory
find_package(Zephyr REQUIRED HINTS $ENV{ZEPHYR_BASE})

# Project and source files
project(eth_http_client_demo)


target_sources(app 
    PRIVATE 
    src/main.c
    src/net_sample_common.c
)

target_include_directories(app
    PRIVATE 
    src/
)
```

## prj.conf
```kconfig
# General
CONFIG_MAIN_STACK_SIZE=3072
CONFIG_SYSTEM_WORKQUEUE_STACK_SIZE=2048

# Networking
CONFIG_NETWORKING=y
CONFIG_NET_IPV4=y
CONFIG_NET_TCP=y
CONFIG_NET_L2_ETHERNET=y
CONFIG_NET_MGMT=y
CONFIG_NET_MGMT_EVENT=y
CONFIG_NET_SOCKETS=y
CONFIG_POSIX_API=y
CONFIG_NET_CONTEXT_NET_PKT_POOL=y
CONFIG_NET_STATISTICS=y
CONFIG_TEST_RANDOM_GENERATOR=y

# Network buffers
CONFIG_NET_PKT_RX_COUNT=16
CONFIG_NET_PKT_TX_COUNT=16
CONFIG_NET_BUF_RX_COUNT=128
CONFIG_NET_BUF_TX_COUNT=128

# Logging
CONFIG_LOG=y

# NOTE: Addded these because the logging on this example is very verbose
CONFIG_LOG_BUFFER_SIZE=2048
CONFIG_LOG_BACKEND_UART_ASYNC=y

# Enable connection manager
CONFIG_NET_CONNECTION_MANAGER=y
CONFIG_HTTP_CLIENT=y
```

## src/main.c
```c
/*
 * Simple HTTP Client Example for Zephyr
 * Based on Zephyr's http_client sample, simplified and using printk
 * Assigns static IP and waits for network connectivity before HTTP request
 */

#include <zephyr/kernel.h>
#include <zephyr/net/socket.h>
#include <zephyr/posix/sys/socket.h>
#include <zephyr/net/http/client.h>
#include <zephyr/net/net_ip.h>
#include <zephyr/net/net_if.h>
#include <zephyr/net/net_core.h>
#include <zephyr/net/ethernet.h>
#include <zephyr/net/phy.h>

#include <zephyr/net/net_mgmt.h>
#include <zephyr/posix/arpa/inet.h> // for inet_pton
#include <zephyr/posix/unistd.h>    // for close
#include <string.h>
#include <stdio.h>
#include "net_sample_common.h"

#define SERVER_IP "192.168.1.1" // Change to your PC/server IP
#define SERVER_PORT 8000
#define RECV_BUF_SIZE 512

static uint8_t recv_buf[RECV_BUF_SIZE];

static int response_cb(struct http_response *rsp, enum http_final_call final_data, void *user_data)
{
    switch (final_data)
    {
    case HTTP_DATA_MORE:
        printk("[HTTP] Partial data received (%zd bytes)\n", rsp->data_len);
        break;
    case HTTP_DATA_FINAL:
        printk("[HTTP] All data received (%zd bytes)\n", rsp->data_len);
        break;
    default:
        break;
    }
    printk("[HTTP] Status: %s\n", rsp->http_status);

    // Print only the body fragment (may be called multiple times)
    if (rsp->body_frag_len > 0 && rsp->body_frag_start)
    {
        printk("[HTTP] Body fragment: %.*s\n", (int)rsp->body_frag_len, rsp->body_frag_start);
    }
    return 0;
}

/**
 * @brief Create and configure a socket for HTTP communication
 *
 * @param server Server IP address (string)
 * @param port Server port
 * @param sock Pointer to socket descriptor (output)
 * @param addr Pointer to sockaddr_in structure (output)
 *
 * @return 0 on success, -1 on failure
 */
static int setup_socket(const char *server, int port, int *sock, struct sockaddr_in *addr)
{
    // Initialize address structure
    memset(addr, 0, sizeof(struct sockaddr_in));
    addr->sin_family = AF_INET;
    addr->sin_port = htons(port);

    // Convert IP address string to binary form
    if (inet_pton(AF_INET, server, &addr->sin_addr) <= 0)
    {
        printk("[ERR] Invalid IP address: %s\n", server);
        return -1;
    }

    // Create TCP socket
    *sock = socket(AF_INET, SOCK_STREAM, IPPROTO_TCP);
    if (*sock < 0)
    {
        printk("[ERR] Failed to create socket (%d)\n", errno);
        return -1;
    }

    return 0;
}

/**
 * @brief Setup socket and connect to server
 *
 * This function combines socket creation and connection to the server.
 * Internally calls setup_socket() and then connects.
 *
 * @param server Server IP address (string)
 * @param port Server port
 * @param sock Pointer to socket descriptor (output)
 * @param addr Pointer to sockaddr_in structure (output)
 *
 * @return 0 on success, -1 on failure
 */
static int connect_socket(const char *server, int port, int *sock, struct sockaddr_in *addr)
{
    int ret;

    // First setup the socket
    ret = setup_socket(server, port, sock, addr);
    if (ret < 0 || *sock < 0)
    {
        return -1;
    }

    // Then connect to server
    ret = connect(*sock, (struct sockaddr *)addr, sizeof(struct sockaddr_in));
    if (ret < 0)
    {
        printk("[ERR] Failed to connect (%d)\n", errno);
        close(*sock);
        *sock = -1;
        return -1;
    }

    return 0;
}

int main(void)
{
    /*
    Dev Note: For this I have decided to use a common function to wrap network connectivity,
    if you need more context about interface example  stounplease review previous samples.
    */
    // Wait for network connectivity
    wait_for_network();

    struct sockaddr_in server_addr;
    int sock = -1;
    int ret;
    struct http_request req;
    int32_t timeout = 3000; // ms

    printk("\n--- Zephyr HTTP Client Example ---\n");
    printk("Connecting to %s:%d\n", SERVER_IP, SERVER_PORT);

    // ===== GET REQUEST =====
    // Setup socket and connect
    ret = connect_socket(SERVER_IP, SERVER_PORT, &sock, &server_addr);
    if (ret < 0)
    {
        return 0;
    }

    // Prepare GET request
    memset(&req, 0, sizeof(req));
    req.method = HTTP_GET;
    req.url = "/";
    req.host = SERVER_IP;
    req.protocol = "HTTP/1.1";
    req.response = response_cb;
    req.recv_buf = recv_buf;
    req.recv_buf_len = sizeof(recv_buf);

    printk("[HTTP] Sending GET request...\n");
    ret = http_client_req(sock, &req, timeout, "GET");
    if (ret < 0)
    {
        printk("[ERR] HTTP client error %d\n", ret);
    }

    // Close GET connection
    close(sock);

    // Small delay between requests
    k_sleep(K_MSEC(500));

    // ===== POST REQUEST =====
    // Setup new socket and connect
    ret = connect_socket(SERVER_IP, SERVER_PORT, &sock, &server_addr);
    if (ret < 0)
    {
        return 0;
    }

    // Prepare POST request
    const char *post_payload = "{\"message\":\"Hello from Zephyr\",\"board\":\"STM32H573I-DK\"}";
    const char *content_type = "application/json";

    memset(&req, 0, sizeof(req));
    req.method = HTTP_POST;
    req.url = "/";
    req.host = SERVER_IP;
    req.protocol = "HTTP/1.1";
    req.response = response_cb;
    req.recv_buf = recv_buf;
    req.recv_buf_len = sizeof(recv_buf);
    req.content_type_value = content_type;
    req.payload = post_payload;
    req.payload_len = strlen(post_payload);

    printk("[HTTP] Sending POST request...\n");
    ret = http_client_req(sock, &req, timeout, "POST");
    if (ret < 0)
    {
        printk("[ERR] HTTP client error %d\n", ret);
    }

    close(sock);
    printk("[HTTP] Done.\n");
}
```

## src/net_sample_common.c
```c
#include <zephyr/net/conn_mgr_connectivity.h>
#include <zephyr/net/conn_mgr_monitor.h>
#include <zephyr/net/net_mgmt.h>
#include <zephyr/kernel.h>

#define MAC_ADDR_LEN 6

static struct net_mgmt_event_callback l4_cb;
static K_SEM_DEFINE(network_connected, 0, 1);

static void assign_static_ip(struct net_if *iface)
{
    struct in_addr addr;
    addr.s_addr = htonl((192UL << 24) | (168UL << 16) | (1UL << 8) | 100UL);
    struct net_if_addr *ifaddr = net_if_ipv4_addr_add(iface, &addr, NET_ADDR_MANUAL, 24);
    if (!ifaddr)
    {
        printk("Failed to add IPv4 address\n");
        return;
    }
    printk("Static IP assigned: 192.168.1.100/24\n");
}

static void l4_event_handler(struct net_mgmt_event_callback *cb, uint64_t event, struct net_if *iface)
{
    switch (event) {
    case NET_EVENT_L4_CONNECTED:
        printk("Network connectivity established and IP address assigned\n");

        char buf[NET_IPV4_ADDR_LEN];

        // Log the assigned static IP address
        printk("IP Address: %s\n",
               net_addr_ntop(NET_AF_INET,
                             &iface->config.ip.ipv4->unicast[0].ipv4.address.in_addr,
                             buf, sizeof(buf)));

        // Log the subnet mask
        printk("Netmask:    %s\n",
               net_addr_ntop(NET_AF_INET,
                             &iface->config.ip.ipv4->unicast[0].netmask,
                             buf, sizeof(buf)));

        // Log the gateway
        printk("Gateway:    %s\n",
               net_addr_ntop(NET_AF_INET,
                             &iface->config.ip.ipv4->gw,
                             buf, sizeof(buf)));

        k_sem_give(&network_connected);
        break;
    case NET_EVENT_L4_DISCONNECTED:
        break;
    default:
        break;
    }
}

void wait_for_network(void)
{
    // Get the default network interface
    struct net_if *iface = net_if_get_default();
    if (!iface)
    {
        printk("ERROR: No network interface found!\n");
        return;
    }

    // Print MAC address
    const struct net_linkaddr *linkaddr = net_if_get_link_addr(iface);
    if (linkaddr && MAC_ADDR_LEN == linkaddr->len)
    {
        printk("MAC Address: %02X:%02X:%02X:%02X:%02X:%02X\n",
               linkaddr->addr[0], linkaddr->addr[1], linkaddr->addr[2],
               linkaddr->addr[3], linkaddr->addr[4], linkaddr->addr[5]);
    }

    // Register L4 connectivity event callback
    net_mgmt_init_event_callback(&l4_cb, l4_event_handler, NET_EVENT_L4_CONNECTED | NET_EVENT_L4_DISCONNECTED);
    net_mgmt_add_event_callback(&l4_cb);
    conn_mgr_mon_resend_status();
    printk("Waiting for network...\n");

    // Assign static IP for the sake of the example
    assign_static_ip(iface);
    k_sem_take(&network_connected, K_FOREVER);
}
```

## src/net_sample_common.h
```c
#ifndef NET_SAMPLE_COMMON_H
#define NET_SAMPLE_COMMON_H

void wait_for_network(void);

#endif // NET_SAMPLE_COMMON_H
```
