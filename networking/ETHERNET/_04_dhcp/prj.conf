## CMakeLists.txt
```
# Minimum CMake required version
cmake_minimum_required( VERSION 3.20.0 )

# Get Zephyr directory
find_package(Zephyr REQUIRED HINTS $ENV{ZEPHYR_BASE})

# Project and source files
project(eth_driver_demo)
target_sources(app PRIVATE src/main.c)
```

## prj.conf
```kconfig
# Core networking
CONFIG_NETWORKING=y
CONFIG_NET_LOG=y
CONFIG_NET_IPV4=y
CONFIG_NET_L2_ETHERNET=y

# Ethernet driver
CONFIG_ETH_DRIVER=y
CONFIG_ETH_STM32_HAL=y

# DHCP client
CONFIG_NET_DHCPV4=y
CONFIG_NET_DHCPV4_OPTION_CALLBACKS=y

# Network management (for IP address assignment events)
CONFIG_NET_MGMT=y
CONFIG_NET_MGMT_EVENT=y

# Logging
CONFIG_LOG=y

# Stack size (DHCP requires more than static IP)
CONFIG_MAIN_STACK_SIZE=3072

# Initialization
CONFIG_INIT_STACKS=y
CONFIG_ENTROPY_GENERATOR=y
```

## src/main.c
```c
/**
 * STM32H573 - DHCP Client
 *
 * How DHCP works:
 * 1. Client sends DISCOVER (broadcasts "who has an IP for me?")
 * 2. Server sends OFFER (offers an available IP address)
 * 3. Client sends REQUEST (confirms it wants that IP)
 * 4. Server sends ACK (confirms, lease is now active)
 *
 * Result: The device gets an IP, netmask, gateway, and lease time automatically.
 */


#include <zephyr/kernel.h>
#include <zephyr/net/net_if.h>
#include <zephyr/net/net_mgmt.h>



// DHCP Option 42: NTP Server address (for time synchronization)
#define DHCP_OPTION_NTP (42)

// Buffer to store NTP server IP received from DHCP server
static uint8_t ntp_server[4];

// Event callback structures - used to listen for network events
static struct net_mgmt_event_callback mgmt_cb;    // Listens for IP address changes
static struct net_dhcpv4_option_callback dhcp_cb; // Listens for DHCP option updates

/**
 * Start DHCP client on a network interface
 *
 * This function is called by net_if_foreach() for each available
 * network interface in the system. We start the DHCP client
 * which will begin the DISCOVER/OFFER/REQUEST/ACK sequence.
 */
static void start_dhcpv4_client(struct net_if *iface, void *user_data)
{
    ARG_UNUSED(user_data);

    // Log which interface we're starting DHCP on
	printk("Starting DHCP on %s (index %d)\n",
		net_if_get_device(iface)->name,
		net_if_get_by_iface(iface));

    // Initiate the DHCP protocol sequence
    net_dhcpv4_start(iface);
}

/**
 * Handle NET_EVENT_IPV4_ADDR_ADD event
 *
 * Triggered when DHCP successfully assigns an IP address to the interface.
 * We extract and display the IP, subnet mask, gateway, and lease duration.
 */
static void handler(struct net_mgmt_event_callback *cb,
                    uint64_t mgmt_event,
                    struct net_if *iface)
{
    int i = 0;

    // Only handle IP address add events
    if (mgmt_event != NET_EVENT_IPV4_ADDR_ADD)
    {
        return;
    }

    // Iterate through all IPv4 addresses on this interface
    for (i = 0; i < NET_IF_MAX_IPV4_ADDR; i++)
    {
        char buf[NET_IPV4_ADDR_LEN];

        // Skip addresses that are not from DHCP
        if (iface->config.ip.ipv4->unicast[i].ipv4.addr_type != NET_ADDR_DHCP)
        {
            continue;
        }

        // Log the assigned IP address
    		printk("IP Address: %s\n",
    			net_addr_ntop(NET_AF_INET,
    						&iface->config.ip.ipv4->unicast[i].ipv4.address.in_addr,
    						buf, sizeof(buf)));

        // Log the subnet mask
    		printk("Netmask:    %s\n",
    			net_addr_ntop(NET_AF_INET,
    						&iface->config.ip.ipv4->unicast[i].netmask,
    						buf, sizeof(buf)));

        // Log the default gateway
    		printk("Gateway:    %s\n",
    			net_addr_ntop(NET_AF_INET,
    						&iface->config.ip.ipv4->gw,
    						buf, sizeof(buf)));

        // Log lease duration: how long until we need to renew the IP
    		printk("Lease time: %u seconds (%u days)\n",
    			iface->config.dhcpv4.lease_time,
    			iface->config.dhcpv4.lease_time / 86400);
    }
}

/**
 * Handle DHCP option responses
 *
 * Some DHCP servers send additional options like NTP servers (option 42).
 * This callback receives those optional parameters.
 */
static void option_handler(struct net_dhcpv4_option_callback *cb,
                           size_t length,
                           enum net_dhcpv4_msg_type msg_type,
                           struct net_if *iface)
{
    char buf[NET_IPV4_ADDR_LEN];

    // Convert the option data to human-readable IP address format
	printk("DHCP Option %d: %s\n",
		cb->option,
		net_addr_ntop(NET_AF_INET, cb->data, buf, sizeof(buf)));
}

int main(void)
{
	printk("STM32H573 DHCP Client\n");
	printk("Waiting for network interface...\n");

    // Register callback to be notified when an IPv4 address is assigned
    net_mgmt_init_event_callback(&mgmt_cb, handler, NET_EVENT_IPV4_ADDR_ADD);
    net_mgmt_add_event_callback(&mgmt_cb);

    // Register callback to receive DHCP options (like NTP server)
    net_dhcpv4_init_option_callback(&dhcp_cb, option_handler,
                                    DHCP_OPTION_NTP, // Option type to listen for
                                    ntp_server,      // Buffer to store the option data
                                    sizeof(ntp_server));
    net_dhcpv4_add_option_callback(&dhcp_cb);

    // Start DHCP on all available network interfaces
    net_if_foreach(start_dhcpv4_client, NULL);

    // Process continues - kernel scheduler handles network events in background
    return 0;
}
```
