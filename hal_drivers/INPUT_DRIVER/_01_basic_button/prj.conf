## CMakeLists.txt
```
# Minimum CMake required version
cmake_minimum_required( VERSION 3.20.0 )

# Get Zephyr directory
find_package(Zephyr REQUIRED HINTS $ENV{ZEPHYR_BASE})

# Project and source files
project(input_driver_demo)
target_sources(app PRIVATE src/main.c)
```

## prj.conf
```kconfig
# Include GPIO driver in system config
CONFIG_GPIO=y

# Include INPUT subsystem
CONFIG_INPUT=y
```

## boards/stm32h573i_dk.overlay
```dts
/*
 * STM32H573I-DK ya tiene un botón de usuario definido en el DTS base:
 *   - gpio_keys/user_button en PC13
 *   - Alias: sw0
 *   - zephyr,code = INPUT_KEY_0
 *
 * No necesitamos redefinir nada en este overlay.
 * El driver gpio-keys lo detectará automáticamente.
 */
```

## boards/xiao_esp32c6_hpcore.overlay
```dts
/ {
	buttons {
		compatible = "gpio-keys";

		user_button: button_0 {
			gpios = <&gpio0 18 (GPIO_ACTIVE_LOW | GPIO_PULL_UP)>;
			label = "External Button Pull-Up GPIO18";
			zephyr,code = <INPUT_KEY_0>;
		};
	};
};
```

## src/main.c
```c
#include <zephyr/kernel.h>
#include <zephyr/input/input.h>

/*
 * Input event callback
 *
 * This function is called whenever an input event is generated by any
 * input device in the system (NULL filter in INPUT_CALLBACK_DEFINE).
 *
 * The gpio-keys driver generates INPUT_EV_KEY events when a button is
 * pressed (value=1) or released (value=0).
 */
static void button_event_cb(struct input_event *evt, void *user_data)
{
    /* Filter for key events with code INPUT_KEY_0 */
    if (evt->type == INPUT_EV_KEY && evt->code == INPUT_KEY_0)
    {
        if (evt->value)
        {
            printk("Button PRESSED\n");
        }
        else
        {
            printk("Button RELEASED\n");
        }
    }
}

/*
 * Register input callback
 *
 * - Device filter: NULL (receives events from all input devices)
 * - Callback function: button_event_cb
 * - User data: NULL (not used)
 */
INPUT_CALLBACK_DEFINE(NULL, button_event_cb, NULL);

int main(void)
{
    printk("Button demo started\n");

    while (1)
    {
        k_sleep(K_FOREVER);
    }
}
```
