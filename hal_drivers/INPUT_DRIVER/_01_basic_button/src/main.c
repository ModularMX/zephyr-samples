#include <zephyr/kernel.h>
#include <zephyr/input/input.h>

/*
 * Input event callback
 *
 * This function is called whenever an input event is generated by any
 * input device in the system (NULL filter in INPUT_CALLBACK_DEFINE).
 *
 * The gpio-keys driver generates INPUT_EV_KEY events when a button is
 * pressed (value=1) or released (value=0).
 */
static void button_event_cb(struct input_event *evt, void *user_data)
{
    /* Filter for key events with code INPUT_KEY_0 */
    if (evt->type == INPUT_EV_KEY && evt->code == INPUT_KEY_0)
    {
        if (evt->value)
        {
            printk("Button PRESSED\n");
        }
        else
        {
            printk("Button RELEASED\n");
        }
    }
}

/*
 * Register input callback
 *
 * - Device filter: NULL (receives events from all input devices)
 * - Callback function: button_event_cb
 * - User data: NULL (not used)
 */
INPUT_CALLBACK_DEFINE(NULL, button_event_cb, NULL);

int main(void)
{
    printk("Button demo started\n");

    while (1)
    {
        k_sleep(K_FOREVER);
    }
}
