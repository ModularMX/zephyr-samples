/ {
    aliases {
        gpio = &gpiof;
    };
};

&gpiof {
    /* Declare an internal node name "pin" and set pin 4 as output with init 
    state as high level, you can read gpio-controller.yaml file to check the 
    rest of the properties */
    pin {
        gpio-hog;
        gpios = <0 GPIO_ACTIVE_HIGH>, <1 GPIO_ACTIVE_HIGH>, <2 GPIO_ACTIVE_HIGH>, <3 GPIO_ACTIVE_HIGH>, <4 GPIO_ACTIVE_HIGH>;
        output-high;
        line-name = "output pin"; 
    };
};