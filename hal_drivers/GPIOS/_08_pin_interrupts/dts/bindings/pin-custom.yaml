## hal_drivers/GPIOS/_08_pin_interrupts/dts/bindings/pin-custom.yaml
```yaml
# binding description
description: pin for multipurpose (input/output) use

# binding name (this is the one will be used in the device tree file)
compatible: "pin-custom"

# properties our node will have, in our case there is just one called gpios
# which will be mandatory and their values are in a multi type array
properties:
  gpios:
    type: phandle-array
    required: true
    description: The GPIO pin connected as input or output.
```

## utils/_01_SRNG/boards/stm32h573i_dk.conf
```kconfig
# Enable SRNG and related test generators
CONFIG_STACK_POINTER_RANDOM=0
CONFIG_TEST_CSPRNG_GENERATOR=y
CONFIG_TEST_RANDOM_GENERATOR=y
CONFIG_TIMER_RANDOM_GENERATOR=y
```

## utils/_02_FPU/boards/stm32h573i_dk.conf
```kconfig
# ============================================================================
# FPU (Floating Point Unit) Configuration
# ============================================================================
#
# This configuration file enables hardware floating point support on ARM Cortex-M
# processors with FPU capabilities. These options are essential for efficient
# floating-point arithmetic operations.
#
# Configuration options can be set here directly or via 'west build -t menuconfig'
# To see available options, use: west build -t menuconfig

# Enable hardware FPU support
# This enables the ARM Floating Point Unit for single and double precision ops
CONFIG_FPU=y

# Use hard floating-point ABI (Application Binary Interface)
# Floating-point arguments and returns are passed in FP registers (more efficient)
# Alternative: CONFIG_FP_SOFTABI=y (passes FP values in general registers)
CONFIG_FP_HARDABI=y

# Enable floating-point support in cbprintf (minimal printk)
# Required to use %f format specifier in printk() and printf() calls
# Without this, printk() ignores %f format specifiers
CONFIG_CBPRINTF_FP_SUPPORT=y

# Disable nano cbprintf (use full-featured cbprintf)
# CONFIG_CBPRINTF_NANO includes minimal features and no FP support
# Setting this to 'n' ensures %f formatting is available
CONFIG_CBPRINTF_NANO=n

# Enable floating-point I/O in picolibc (standard C library)
# Provides proper %f/%e/%g format conversion in scanf/printf family functions
# Essential for printing and parsing floating-point values with standard formats
CONFIG_PICOLIBC_IO_FLOAT=y
```
