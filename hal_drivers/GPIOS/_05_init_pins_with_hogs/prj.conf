## prj.conf
```kconfig
# Disable optimizations
CONFIG_NO_OPTIMIZATIONS=y
# Include GPIO driver in system config ( Kconfig )
CONFIG_GPIO=y
# Option to init pins using the DTC
CONFIG_GPIO_HOGS=y
```

## boards/frdm_mcxa156.overlay
```dts
/ {
    aliases {
        gpio = &gpio3;
    };
};

&gpio3 {
    /* Declare an internal node name "pin" and set pin 12 as output with init 
    state as high level, you can read gpio-controller.yaml file to check the 
    rest of the properties */
    pin {
        gpio-hog;
        gpios = <12 GPIO_ACTIVE_HIGH>;
        output-high;
        line-name = "output pin"; 
    };
};
```

## boards/mcx_n9xx_evk_mcxn947_cpu0.overlay
```dts
/ {
    aliases {
        gpio = &gpio0;
    };
};

&gpio2 {
    /* Declare an internal node name "pin" and set pin 9 as output with init 
    state as high level, you can read gpio-controller.yaml file to check the 
    rest of the properties */
    pin {
        gpio-hog;
        gpios = <10 GPIO_ACTIVE_HIGH>;
        output-high;
        line-name = "output pin"; 
    };
};
```

## boards/native_sim.overlay
```dts
/ {
    aliases {
        gpio = &gpio0;
    };
};

&gpio0 {
    /* Declare an internal node name "pin" and set pin 0 as output with init 
    state as high level, you can read gpio-controller.yaml file to check the 
    rest of the properties */
    pin {
        gpio-hog;
        gpios = <0 GPIO_ACTIVE_HIGH>;
        output-high;
        line-name = "output pin"; 
    };
};
```

## boards/nrf54l15dk_nrf54l15_cpuapp.overlay
```dts
/ {
    aliases {
        gpio = &gpio2;
    };
};

&gpio2 {
    /* Declare an internal node name "pin" and set pin 9 as output with init 
    state as high level, you can read gpio-controller.yaml file to check the 
    rest of the properties */
    pin {
        gpio-hog;
        gpios = <9 GPIO_ACTIVE_HIGH>;
        output-high;
        line-name = "output pin"; 
    };
};
```

## boards/nucleo_g0b1re.overlay
```dts
/ {
    aliases {
        gpio = &gpioa;
    };
};

&gpioa {
    /* Declare an internal node name "pin" and set pin 5 as output with init 
    state as high level, you can read gpio-controller.yaml file to check the 
    rest of the properties */
    pin {
        gpio-hog;
        gpios = <5 GPIO_ACTIVE_HIGH>;
        output-high;
        line-name = "output pin"; 
    };
};
```

## boards/stm32h573i_dk.overlay
```dts
/ {
    aliases {
        gpio = &gpiof;
    };
};
```

## src/main.c
```c
/**
 * @file main.c
 * @brief Initialize one pin using DTC hogs
 * 
 * This sample application shows how to configure a pin as output
 * using a hog in the device tree. The pin is toggled every 300ms
 * in the main loop using a port function.
 */
/* Include libraries */
#include <zephyr/kernel.h>
#include <zephyr/drivers/gpio.h>


/*we are using pin functions with no access to device tree, so the onlyway to achieve 
hardware agnostic is use adefine with the pin to use way to achieve hardware agnostic 
is use adefine with the pin to use according to board in use (use of kconfig to define 
a pin is not recommended according to official Zephyr documentation)*/
#if defined(CONFIG_BOARD_NRF54L15DK)
    #define PORT_PIN 9
#elif defined(CONFIG_BOARD_NUCLEO_G0B1RE)
    #define PORT_PIN 5
#elif defined(CONFIG_BOARD_STM32H573I_DK)
    #define PORT_PIN 4
#elif defined(CONFIG_BOARD_MCX_N9XX_EVK)
    #define PORT_PIN 10
#elif defined(CONFIG_BOARD_FRDM_MCXA156)
    #define PORT_PIN 12
#elif defined(CONFIG_BOARD_NATIVE_SIM)
    #define PORT_PIN 0
#else
    #error "Define the pin to toggle for your board"
#endif 

/* Get the device descriptor for port with the pin connected */
const struct device *port = DEVICE_DT_GET( DT_ALIAS(gpio) );

int main( void )
{
    /* No need to call any configuration function */

    while(1)
    {
        /* Toggle pin 9 from port 2 using a port function */
        gpio_pin_toggle( port, PORT_PIN );
        /* 300ms Delay */
        k_msleep( 300 );
    }
    return 0;
}
```
